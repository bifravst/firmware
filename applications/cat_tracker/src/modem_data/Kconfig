## applications/cat_tracker/src/modem_data/Kconfig
```kconfig
#
# Copyright (c) 2019 Nordic Semiconductor ASA
#
# SPDX-License-Identifier: LicenseRef-BSD-5-Clause-Nordic
#

menu "MODEM_DATA"

config MODEM_DATA
	bool "Interface for modem info module"
	default y
	select MODEM_INFO

if MODEM_DATA

module = MODEM_DATA
module-str = modem info interface
source "${ZEPHYR_BASE}/subsys/logging/Kconfig.template.log_config"

endif # MODEM_DATA

endmenu
```

## applications/cat_tracker/src/ui/Kconfig
```kconfig
#
# Copyright (c) 2019 Nordic Semiconductor ASA
#
# SPDX-License-Identifier: LicenseRef-BSD-5-Clause-Nordic
#

config USE_UI_MODULE
	bool "Enable UI module"
	default y
	help
		Enable the User Interface module for user interaction on
		development kit / Thingy91 hardware.

menu "User Interface"
	visible if USE_UI_MODULE

config UI_LED_USE_PWM
	bool "Use PWM to control LEDs"
	default y if BOARD_NRF9160_PCA20035NS || BOARD_NRF9160_PCA10015NS
	select PWM if BOARD_NRF9160_PCA20035NS || BOARD_NRF9160_PCA10015NS
	select PWM_0 if BOARD_NRF9160_PCA20035NS || BOARD_NRF9160_PCA10015NS

if UI_LED_USE_PWM

config UI_LED_PWM_DEV_NAME
	string "PWM device name for RGB LED"
	default "$(dt_str_val,DT_NORDIC_NRF_PWM_PWM_0_LABEL)" if BOARD_NRF9160_PCA20035NS || BOARD_NRF9160_PCA10015NS

config UI_LED_RED_PIN
	int "Red LED pin number"
	default $(dt_int_val,DT_NORDIC_NRF_PWM_PWM_0_CH0_PIN)

config UI_LED_GREEN_PIN
	int "Green LED pin number"
	default $(dt_int_val,DT_NORDIC_NRF_PWM_PWM_0_CH1_PIN)

config UI_LED_BLUE_PIN
	int "Blue LED pin number"
	default $(dt_int_val,DT_NORDIC_NRF_PWM_PWM_0_CH2_PIN)

endif # UI_LED_USE_PWM

endmenu

module = UI
module-str = User Interface
source "${ZEPHYR_BASE}/subsys/logging/Kconfig.template.log_config"
```

## boards/arm/nrf9160_pca10015/Kconfig.board
```kconfig
# Kconfig - nRF91 PCA10015 board configuration
#
# Copyright (c) 2019 Nordic Semiconductor ASA
#
# SPDX-License-Identifier: LicenseRef-BSD-5-Clause-Nordic

if SOC_NRF9160_SICA

config BOARD_NRF9160_PCA10015
	bool "nRF9160 PCA10015"
	depends on !TRUSTED_EXECUTION_NONSECURE

config BOARD_NRF9160_PCA10015NS
	bool "nRF9160 PCA10015 non-secure"
	depends on TRUSTED_EXECUTION_NONSECURE

endif # SOC_NRF9160_SICA
```

## lib/nrf9160_timestamp/Kconfig
```kconfig
#
# Copyright (c) 2019 Nordic Semiconductor ASA
#
# SPDX-License-Identifier: LicenseRef-BSD-5-Clause-Nordic
#

config NRF9160_TIMESTAMP
	bool "nRF9160 timestamp module"
	select AT_CMD
	select SNTP

if NRF9160_TIMESTAMP

config NRF9160_TIMESTAMP_TIME_UPDATE_INTERVAL
	int "Time update interval"
	default 3600

config NRF9160_TIMESTAMP_DEV_NAME
	string "Name of the nrf9160 timestamp device name"
	default "NRF9160_TIMESTAMP_DEV"

config NRF9160_TIME_NTP_THREAD_SIZE
	int "Stack size of the thread maintaining NTP"
	default 2048

module=NRF9160_TIMESTAMP
module-dep=LOG
module-str=nRF9160 timestamp module
source "${ZEPHYR_BASE}/subsys/logging/Kconfig.template.log_config"

endif # NRF9160_TIMESTAMP
```

## src/cloud_codec/Kconfig
```kconfig
#
# Copyright (c) 2020 Nordic Semiconductor
#
# SPDX-License-Identifier: LicenseRef-BSD-5-Clause-Nordic
#

menu "Cloud codec"

config SERIALIZATION_JSON
	bool "Cloud communication enconding"
	default y
	select CJSON_LIB

config GPS_BUFFER_MAX
	int "Sets the number of entries in the GPS buffer"
	default 20

config SENSOR_BUFFER_MAX
	int "Sets the number of entries in the sensor buffer"
	default 20

config MODEM_BUFFER_MAX
	int "Sets the number of entries in the modem buffer"
	default 20

config UI_BUFFER_MAX
	int "Sets the number of entries in the UI buffer"
	default 20

config ACCEL_BUFFER_MAX
	int "Sets the number of entries in the accelerometer buffer"
	default 20

config BAT_BUFFER_MAX
	int "Sets the number of entries in the battery buffer"
	default 20

config TIME_BETWEEN_ACCELEROMETER_BUFFER_STORE_SEC
	int "Time in between accelerometer buffer updates"
	default 10

endmenu # Cloud codec
```

## src/events/Kconfig
```kconfig
#
# Copyright (c) 2020 Nordic Semiconductor
#
# SPDX-License-Identifier: LicenseRef-BSD-5-Clause-Nordic
#

if LOG

menu "Event options"

comment "Initially logged events"

config APP_MGR_EVENTS_LOG
	bool "Enable logging for application manager events"
	default y

config MODEM_MGR_EVENTS_LOG
	bool "Enable logging for modem manager events"
	default y

config CLOUD_MGR_EVENTS_LOG
	bool "Enable logging for cloud manager events"
	default y

config SENSOR_MGR_EVENTS_LOG
	bool "Enable logging for sensor manager events"
	default y

config UI_MGR_EVENTS_LOG
	bool "Enable logging for UI manager events"
	default y

config UTIL_MGR_EVENTS_LOG
	bool "Enable logging for utility manager events"
	default y

config GPS_MGR_EVENTS_LOG
	bool "Enable logging for GPS manager events"
	default y

config DATA_MGR_EVENTS_LOG
	bool "Enable logging for data manager events"
	default y

config OUTPUT_MGR_EVENTS_LOG
	bool "Enable logging for output manager events"
	default y

endmenu

endif
```

## src/ext_sensors/Kconfig
```kconfig
#
# Copyright (c) 2020 Nordic Semiconductor
#
# SPDX-License-Identifier: LicenseRef-BSD-5-Clause-Nordic
#

menu "External sensors"

config EXTERNAL_SENSORS
	bool "Enable external sensors"
	default y if BOARD_THINGY91_NRF9160NS || BOARD_NRF9160_PCA10015NS

config ACCELEROMETER_DEV_NAME
	string "Accelerometer device name"

config MULTISENSOR_DEV_NAME
	string "Multisensor device name"

config ACCELEROMETER_TRIGGER
	bool "Accelerometer trigger"

endmenu # External sensors
```

## src/managers/Kconfig
```kconfig
#
# Copyright (c) 2020 Nordic Semiconductor
#
# SPDX-License-Identifier: LicenseRef-BSD-5-Clause-Nordic
#

menu "GPS manager"

config GPS_MANAGER
	bool ""
	default y

if GPS_MANAGER

config GPS_MGR_THREAD_STACK_SIZE
	int ""
	default 1024

config GPS_DEV_NAME
	string "GPS device name"
	default "NRF9160_GPS"

endif

endmenu # GPS manager

menu "Modem manager"

config MODEM_MANAGER
	bool
	default y

if MODEM_MANAGER

config MODEM_MGR_THREAD_STACK_SIZE
	int ""
	default 1024

config EXPECTED_MODEM_FIRMWARE_VERSION
	string "The expected modem firmware version"
	default "mfw_nrf9160_1.2.1"

config CAT_TRACKER_APP_VERSION
	string "The version of the cat tracker firmware"
	default "0.0.0-development"

endif

endmenu # Modem manager

menu "Cloud manager"

config CLOUD_MANAGER
	bool ""
	default y

if CLOUD_MANAGER

config CLOUD_MGR_THREAD_STACK_SIZE
	int ""
	default 6000

config CLOUD_BACKEND
	string
	default "AWS_IOT"

config USE_CUSTOM_MQTT_CLIENT_ID
	bool "Use custom MQTT client ID"
	help
	  By default the device's IMEI is used as the client ID
	  for the MQTT connection. This allows to use a fixed
	  value instead. This is mostly useful when providing
	  firmware builds to continuous integration tests on
	  real hardware.
	  Note: you must only run this firmware build on one
	  device at a time.

config MQTT_CLIENT_ID
	depends on USE_CUSTOM_MQTT_CLIENT_ID
	string	"Configures the custom MQTT client ID"
	default "yoghurt"

config CLOUD_CONNECT_RETRIES
	int "Number of times the device will try to reconnect to cloud"
	default 10

endif

endmenu # Cloud manager

menu "UI manager"

config UI_MANAGER
	bool ""
	default y

if UI_MANAGER

config UI_MGR_THREAD_STACK_SIZE
	int ""
	default 256

endif

endmenu # UI manager

menu "OUTPUT manager"

config OUTPUT_MANAGER
	bool ""
	select USE_UI_MODULE
	default y

if OUTPUT_MANAGER

config OUTPUT_MGR_THREAD_STACK_SIZE
	int ""
	default 512

rsource "../ui/Kconfig"

endif

endmenu # OUTPUT manager

menu "Data manager"

config DATA_MANAGER
	bool ""
	default y

if DATA_MANAGER

config DATA_MGR_THREAD_STACK_SIZE
	int ""
	default 2048

rsource "../cloud_codec/Kconfig"

endif

endmenu # Data manager

menu "Sensor manager"

config SENSOR_MANAGER
	bool ""
	default y

if SENSOR_MANAGER

config SENSOR_MGR_THREAD_STACK_SIZE
	int ""
	default 1024

rsource "../ext_sensors/Kconfig"

endif

endmenu # Sensor manager

menu "Utility Manager"

config UTIL_MANAGER
	bool ""
	default y

if UTIL_MANAGER

config UTIL_MGR_THREAD_STACK_SIZE
	int ""
	default 1024

config REBOOT_TIMEOUT
	int "Sets the time from a fatal error or reboot request to reboot"
	default 30
	help
	  This option specifies the timeout that the utility manager will
	  initiate a reboot regardless if the other managers has reported
	  that they are ready for a reboot or not.

endif

endmenu # Utility Manager
```

## src/watchdog/Kconfig
```kconfig
#
# Copyright (c) 2020 Nordic Semiconductor
#
# SPDX-License-Identifier: LicenseRef-BSD-5-Clause-Nordic
#

if WATCHDOG

menu "Watchdog"

config WATCHDOG_TIMEOUT_SEC
	int "Watchdog timeout in seconds"
	default 60

endmenu # Watchdog

endif
```

## subsys/net/lib/bifravst_cloud/Kconfig
```kconfig
# Copyright (c) 2019 Nordic Semiconductor
#
# SPDX-License-Identifier: LicenseRef-BSD-5-Clause-Nordic
#

menuconfig BIFRAVST_CLOUD
	bool "BIFRAVST Cloud library"
	select CJSON_LIB
	imply MQTT_LIB
	imply MQTT_LIB_TLS
	imply AT_CMD

if BIFRAVST_CLOUD

config BIFRAVST_CLOUD_STATIC_IPV4
	bool "Enable use of static IPv4"

config BIFRAVST_CLOUD_STATIC_IPV4_ADDR
	string "Static IPv4 address"
	depends on BIFRAVST_CLOUD_STATIC_IPV4

config BIFRAVST_CLOUD_SEC_TAG
	int "Security tag to use for Bifravst Cloud connection"
	default 42

config BIFRAVST_CLOUD_HOST_NAME
	string "Bifravst Cloud server hostname"

config BIFRAVST_CLOUD_PORT
	int "Bifravst Cloud server port"
	default 8883

config BIFRAVST_CLOUD_MQTT_RX_TX_BUFFER_LEN
	int "Buffer sizes for the MQTT library."
	default 2048
	help
	  Specifies maximum message size can be transmitted/received through
	  MQTT (exluding MQTT PUBLISH payload).

config BIFRAVST_CLOUD_MQTT_PAYLOAD_BUFFER_LEN
	int "Size of the buffer for MQTT PUBLISH payload."
	default 2048

config BIFRAVST_CLOUD_IPV6
	bool "Configure Bifravst Cloud library to use IPv6 addressing. Otherwise IPv4 is used."

module=BIFRAVST_CLOUD
module-dep=LOG
module-str=Bifravst Cloud
source "${ZEPHYR_BASE}/subsys/logging/Kconfig.template.log_config"

endif # BIFRAVST_CLOUD
```
